## boards/shields/Kconfig.deconfig
```kconfig
# SPDX-License-Identifier: MIT

if SHIELD_SOFLE_LEFT || SHIELD_SOFLE_RIGHT

config ZMK_KEYBOARD_NAME
    default "Sofle"

config ZMK_SPLIT
    default y

config ZMK_SPLIT_BLE
    default y

config ZMK_BLE
    default y

config ZMK_USB
    default y

# OLED Display Configuration
config DISPLAY
    default y

config SSD1306
    default y

config I2C
    default y

# Increase BLE signal strength
config BT_CTLR_TX_PWR_PLUS_8
    default y

# Battery reporting
config ZMK_BATTERY_REPORTING
    default y

# RGB Underglow (disable for better battery life)
config RGBLED
    # default n

endif
```

## boards/shields/sofle/Kconfig.defconfig
```kconfig
if SHIELD_SOFLE_LEFT || SHIELD_SOFLE_RIGHT

config ZMK_KEYBOARD_NAME
    default "Sofle"

config ZMK_SPLIT_ROLE_CENTRAL
    default y

config ZMK_SPLIT
    default y

config ZMK_BLE
    default y

config ZMK_USB
    default y

# Display
config ZMK_DISPLAY
    default y

# Battery reporting
config ZMK_BATTERY_REPORTING
    default y

# RGB - Disabled by default for battery life
config RGBLED
    default n

endif
```

## boards/shields/sofle/Kconfig.shield
```kconfig
# SPDX-License-Identifier: MIT

menu "Sofle Shield"

config SHIELD_SOFLE
    bool "Sofle Wireless Shield"
    depends on BOARD_NICE_NANO_V2
    select ZMK_KEYBOARD_CUSTOM
    help
      Enable support for the Sofle split keyboard (with nice!nano v2).

endmenu
```

## boards/shields/sofle/sofle_left/Kconfig.defconfig
```kconfig
# SPDX-License-Identifier: MIT

# This sets default config for the left half (central) side.

if SHIELD_SOFLE_LEFT

config ZMK_KEYBOARD_NAME
    default "Sofle"

# Mark it as a split keyboard (central half).
config ZMK_SPLIT
    default y
config ZMK_SPLIT_ROLE_CENTRAL
    default y

# BLE + USB dual mode
config ZMK_BLE
    default y
config ZMK_USB
    default y

# Increase BLE transmit power
config BT_CTLR_TX_PWR_PLUS_8
    default y

# Battery info from the central side
config ZMK_BATTERY_REPORTING
    default y
config ZMK_SPLIT_BLE_CENTRAL_BATTERY_LEVEL_PROXY
    default y
config ZMK_SPLIT_BLE_CENTRAL_BATTERY_LEVEL_FETCHING
    default y

# Display
config ZMK_DISPLAY
    default y

endif
```

## boards/shields/sofle/sofle_left/Kconfig.shield
```kconfig
# SPDX-License-Identifier: MIT

menu "Sofle Left Shield"

config SHIELD_SOFLE_LEFT
    bool "Sofle Left"
    depends on BOARD_NICE_NANO_V2
    select ZMK_KEYBOARD_CUSTOM
    help
      Enable support for the left (central) half of a Sofle split on nice!nano v2.

endmenu
```

## boards/shields/sofle/sofle_left/sofle_right/Kconfig.defconfig
```kconfig
# SPDX-License-Identifier: MIT

if SHIELD_SOFLE_RIGHT

config ZMK_KEYBOARD_NAME
    string
    default "Sofle Right"

config ZMK_SPLIT
    bool
    default y

# Mark it as the peripheral half
config ZMK_SPLIT_ROLE_PERIPHERAL
    bool
    default y

# Typically, the peripheral half doesn't need BLE advertising, 
# but must still build with SPLIT + BLE if you do real wireless communication between halves.
config ZMK_BLE
    bool
    default y

# If you have a display on the right side as well:
config ZMK_DISPLAY
    bool
    default y

config ZMK_NICE_VIEW_DISPLAY
    bool
    default y

# If your right half also has underglow
config ZMK_RGB_UNDERGLOW
    bool
    default y

config ZMK_RGB_UNDERGLOW_WS2812
    bool
    default y

config ZMK_RGB_UNDERGLOW_COUNT
    int
    default 30

config ZMK_RGB_UNDERGLOW_SPEED
    bool
    default y

config ZMK_RGB_UNDERGLOW_EFFECT_RANGE
    bool
    default y

config ZMK_BEHAVIOR_ROTARY_ENCODER
    bool
    default y

endif # SHIELD_SOFLE_RIGHT
```

## boards/shields/sofle/sofle_right/Kconfig.defconfig
```kconfig
# SPDX-License-Identifier: MIT

# This sets defaults for the right half (peripheral) side.

if SHIELD_SOFLE_RIGHT

config ZMK_KEYBOARD_NAME
    default "Sofle"

config ZMK_SPLIT
    default y
config ZMK_SPLIT_ROLE_PERIPHERAL
    default y

config ZMK_BLE
    default y
config ZMK_USB
    default y

# Increase BLE transmit power on the peripheral side too.
config BT_CTLR_TX_PWR_PLUS_8
    default y

# Peripheral side typically doesn't do battery fetching or proxy,
# but we can still enable battery reporting if the hardware is the same.
config ZMK_BATTERY_REPORTING
    default y

# If you have an OLED or other display on the right side, enable:
config ZMK_DISPLAY
    default y

endif
```

## boards/shields/sofle/sofle_right/Kconfig.shield
```kconfig
# SPDX-License-Identifier: MIT

menu "Sofle Right Shield"

config SHIELD_SOFLE_RIGHT
    bool "Sofle Right"
    depends on BOARD_NICE_NANO_V2
    select ZMK_KEYBOARD_CUSTOM
    help
      Enable support for the right (peripheral) half of a Sofle split on nice!nano v2.

endmenu
```
